## main/Kconfig.projbuild
```kconfig
menu "Example Configuration"
    choice
        prompt "Publish Type"
        default EXAMPLE_NAN_PUBLISH_UNSOLICITED
        config EXAMPLE_NAN_PUBLISH_UNSOLICITED
            bool "UNSOLICITED"
        config EXAMPLE_NAN_PUBLISH_SOLICITED
            bool "SOLICITED"
    endchoice
endmenu
```

## sdkconfig.defaults
```kconfig
# Config flasher
#CONFIG_ESPTOOLPY_FLASHMODE_QIO=y
#CONFIG_ESPTOOLPY_FLASHFREQ_80M=y
CONFIG_ESPTOOLPY_FLASHSIZE_4MB=y


# Use NaN
# CONFIG_ESP_WIFI_NAN_ENABLE=y

# Enable C++ exceptions and set emergency pool size for exception objects
CONFIG_COMPILER_CXX_EXCEPTIONS=y
CONFIG_COMPILER_CXX_EXCEPTIONS_EMG_POOL_SIZE=1024

# Disabled NVS during testing
# CONFIG_ESP_PHY_RF_CAL_FULL=y
# CONFIG_ESP_PHY_CALIBRATION_MODE=2
# CONFIG_ESP_PHY_CALIBRATION_AND_DATA_STORAGE=n

# ENABLE IPV6
# CONFIG_LWIP_IPV6=y

# Enable Websockets
CONFIG_HTTPD_WS_SUPPORT=y

# Take control of flash NAND
CONFIG_PARTITION_TABLE_CUSTOM=y

# Disable SSL: this is not an Internet device.
CONFIG_MBEDTLS_SSL_MAX_CONTENT_LEN=512
CONFIG_MBEDTLS_ASYMMETRIC_CONTENT_LEN=n
CONFIG_MBEDTLS_SSL_KEEP_PEER_CERTIFICATE=n
CONFIG_MBEDTLS_PKCS7_C=n
CONFIG_MBEDTLS_CERTIFICATE_BUNDLE=n
CONFIG_MBEDTLS_SHA512_C=n
CONFIG_MBEDTLS_KEY_EXCHANGE_RSA=n
CONFIG_MBEDTLS_KEY_EXCHANGE_ECDHE_RSA=n
CONFIG_MBEDTLS_KEY_EXCHANGE_ECDH_RSA=n
CONFIG_MBEDTLS_SSL_RENEGOTIATION=n
# This option needs to be stubbed
# https://www.esp32.com/viewtopic.php?t=30699
CONFIG_MBEDTLS_SSL_PROTO_TLS1_2=y
CONFIG_MBEDTLS_SSL_ALPN=n
CONFIG_MBEDTLS_CLIENT_SSL_SESSION_TICKETS=n
CONFIG_MBEDTLS_SERVER_SSL_SESSION_TICKETS=n
CONFIG_MBEDTLS_ECP_DP_SECP192R1_ENABLED=n
CONFIG_MBEDTLS_ECP_DP_SECP224R1_ENABLED=n
CONFIG_MBEDTLS_ECP_DP_SECP384R1_ENABLED=n
CONFIG_MBEDTLS_ECP_DP_SECP521R1_ENABLED=n
CONFIG_MBEDTLS_ECP_DP_SECP192K1_ENABLED=n
CONFIG_MBEDTLS_ECP_DP_SECP224K1_ENABLED=n
CONFIG_MBEDTLS_ECP_DP_BP256R1_ENABLED=n
CONFIG_MBEDTLS_ECP_DP_BP512R1_ENABLED=n
```
